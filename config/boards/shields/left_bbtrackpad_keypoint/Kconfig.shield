## config/boards/shields/left_bbtrackpad_keypoint/Kconfig.shield
```kconfig
# Copyright (c) 2022 The ZMK Contributors
# SPDX-License-Identifier: MIT

config SHIELD_LEFT_BBTRACKPAD_KEYPOINT
    def_bool $(shields_list_contains,left_bbtrackpad_keypoint)

menu "A320 Trackpad Setting"

config A320_LOG_LEVEL
	int "Log Level for Touch"
	default 4

endmenu


menu "A320 Advanced Settings"

config A320_START_IN_SCROLL_MODE
    bool "Start in scroll mode by default"
    default y
    help
      If yes (y), the default state is scroll mode, and holding the toggle key switches to mouse mode.
      If no (n), the default state is mouse mode, and holding the toggle key switches to scroll mode.

config A320_MOUSE_SENS_BASE_PERCENT
    int "Mouse sensitivity base (Percentage, 40 = 0.4)"
    default 40

config A320_MOUSE_SENS_STEP_PERCENT
    int "Mouse sensitivity step per LED brightness (Percentage, 1 = 0.01)"
    default 1

endmenu
```

## config/boards/shields/lpm_view/Kconfig.defconfig
```kconfig
# Copyright (c) 2023 The ZMK Contributors
# SPDX-License-Identifier: MIT

if SHIELD_LPM_VIEW
config LV_Z_VDB_SIZE
    default 100

config LV_DPI_DEF
    default 144

config LV_Z_BITS_PER_PIXEL
    default 1

choice LV_COLOR_DEPTH
    default LV_COLOR_DEPTH_1
endchoice

choice ZMK_DISPLAY_WORK_QUEUE
    default ZMK_DISPLAY_WORK_QUEUE_DEDICATED
endchoice

choice ZMK_DISPLAY_STATUS_SCREEN
    default ZMK_DISPLAY_STATUS_SCREEN_CUSTOM
endchoice

config LV_Z_MEM_POOL_SIZE
    default 4096 if ZMK_DISPLAY_STATUS_SCREEN_CUSTOM

config ZMK_DISPLAY_STATUS_SCREEN_CUSTOM
    imply NICE_VIEW_WIDGET_STATUS

config NICE_VIEW_WIDGET_STATUS
    bool "Custom nice!view status widget"
    select LV_FONT_MONTSERRAT_16
    select LV_USE_IMG
    select LV_USE_CANVAS

config NICE_VIEW_WIDGET_INVERTED
    bool "Invert custom status widget colors"

# The one statement of "live data is compiled in". CMake selects the LiveData
# sources on it and every #if site tests IS_ENABLED(CONFIG_KEYPOINT_LIVE_DATA);
# it is undefined (and so false) in builds without this shield.
config KEYPOINT_LIVE_DATA
    bool
    default y if ZMK_DISPLAY && NICE_VIEW_WIDGET_STATUS && (!ZMK_SPLIT || ZMK_SPLIT_ROLE_CENTRAL)

if !ZMK_SPLIT || ZMK_SPLIT_ROLE_CENTRAL

config NICE_VIEW_WIDGET_STATUS
    select LV_FONT_MONTSERRAT_18
    select LV_FONT_MONTSERRAT_14
    select LV_FONT_UNSCII_8

endif # !ZMK_SPLIT || ZMK_SPLIT_ROLE_CENTRAL

config ZMK_DISPLAY_STATUS_SCREEN_BUILT_IN
    select LV_FONT_MONTSERRAT_26

endif # SHIELD_LPM_VIEW
```

## config/boards/shields/right_trackpoint_keypoint/Kconfig.shield
```kconfig
# Copyright (c) 2022 The ZMK Contributors
# SPDX-License-Identifier: MIT

config SHIELD_RIGHT_TRACKPOINT_KEYPOINT
    def_bool $(shields_list_contains,right_trackpoint_keypoint)


menu "TrackPoint Advanced Settings"

config TRACKPOINT_EXPONENTIAL
    bool "Enable TrackPoint exponential acceleration"
    default y
    help
      Enable exponential acceleration for TrackPoint movement,

config TRACKPOINT_MOUSE_BASE_SPEED_PERCENT
    int "Mouse base speed (Percentage, 50 = 0.5)"
    default 50

config TRACKPOINT_MOUSE_SENS_BASE_PERCENT
    int "Mouse sensitivity base (Percentage, 30 = 0.3)"
    default 30

config TRACKPOINT_MOUSE_SENS_STEP_PERCENT
    int "Mouse sensitivity step per LED brightness (Percentage, 1 = 0.01)"
    default 1


endmenu
```
